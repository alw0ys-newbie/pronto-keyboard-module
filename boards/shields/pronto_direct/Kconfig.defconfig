## boards/shields/pronto_direct/Kconfig.defconfig
```kconfig
if SHIELD_PRONTO_DIRECT

config ZMK_KEYBOARD_NAME
    default "Pronto Direct"

endif
```

## boards/shields/pronto_double/Kconfig.shield
```kconfig
config SHIELD_PRONTO_DOUBLE_LEFT
    def_bool $(shields_list_contains,pronto_double_left)


config SHIELD_PRONTO_DOUBLE_RIGHT
    def_bool $(shields_list_contains,pronto_double_right)
```

## boards/shields/pronto_matrix/Kconfig.defconfig
```kconfig
if SHIELD_PRONTO_MATRIX

config ZMK_KEYBOARD_NAME
    default "Pronto Matrix"

endif
```

## boards/shields/pronto_split/Kconfig.shield
```kconfig
config SHIELD_PRONTO_SPLIT_LEFT
    def_bool $(shields_list_contains,pronto_split_left)


config SHIELD_PRONTO_SPLIT_RIGHT
    def_bool $(shields_list_contains,pronto_split_right)
```
